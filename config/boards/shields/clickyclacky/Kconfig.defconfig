## config/boards/shields/clickyclacky/Kconfig.defconfig
```kconfig
if SHIELD_CLICK_LEFT

config ZMK_KEYBOARD_NAME
    default "ClickyClacky"

config ZMK_SPLIT_ROLE_CENTRAL
    default y

endif

if SHIELD_CLICK_LEFT || SHIELD_CLICK_RIGHT

config ZMK_SPLIT_BLE
    default y

endif
```

## config/boards/shields/clickyclacky/Kconfig.shield
```kconfig
config SHIELD_CLICK_LEFT
    def_bool $(shields_list_contains,clickyclacky_left)

config SHIELD_CLICK_RIGHT
    def_bool $(shields_list_contains,clickyclacky_right)
```
